# 28M36x_GpioG2Ctrl_Registers register map
Vendor: Texas Instruments
Peripheral module from a debugger description file (folder C2000).
Address unit: 16 bits
Registers are 32-bit, access not given, no defined reset value unless marked. A register's access mark holds for its fields unless they carry their own. Offsets are as the file gives them; lines under a group give offsets from that group; [hi:lo] are bit positions; {n}, {i} and the like mark numbered series; 'fields as' and 'values as' point back to an identical list; <NAME> marks a mode.

## GPIOG2_CTRL_REGS — GPIOG2 CTRL REGS Registers
0x00 GPGCTRL — GPIO G Control Register (GPIO128 to 135)
0x02 GPGQSEL1 — GPIO G Qualifier Select 1 Register (GPIO192 to 199)
0x06 GPGMUX1 — GPIO G Mux 1 Register (GPIO192 to 199)
0x0A GPGDIR — GPIO G Direction Register (GPIO192 to 199)
0x0C GPGPUD — GPIO G Pull Up Disable Register (GPIO192 to 199)
0x36 AIOMUX1 — Analog IO Mux 1 Register (AIO0-15)
0x38 AIOMUX2 — Analog IO Mux 2 Register (AIO16-31)
0x3A AIODIR — Analog IO Direction Register (AIO0-31)
