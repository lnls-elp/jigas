# 28M36x_GpioG2Dat_Registers register map
Vendor: Texas Instruments
Peripheral module from a debugger description file (folder C2000).
Address unit: 16 bits
Registers are 32-bit, access not given, no defined reset value unless marked. A register's access mark holds for its fields unless they carry their own. Offsets are as the file gives them; lines under a group give offsets from that group; [hi:lo] are bit positions; {n}, {i} and the like mark numbered series; 'fields as' and 'values as' point back to an identical list; <NAME> marks a mode.

## GPIOG2_DATA_REGS — GPIOG2 DATA REGS Registers
0x00 GPGDAT — GPIO G Data Register (GPIO192 to 199)
0x02 GPGSET — GPIO G Data Set Register (GPIO192 to 199)
0x04 GPGCLEAR — GPIO G Data Clear Register (GPIO192 to 199)
0x06 GPGTOGGLE — GPIO G Data Toggle Register (GPIO192 to 199)
0x18 AIODAT — Analog IO Data Register (AIO0 to 31)
0x1A AIOSET — Analog IO Data Set Register (AIO0 to 31)
0x1C AIOCLEAR — Analog IO Data Clear Register (AIO0 to 31)
0x1E AIOTOGGLE — Analog IO Data Toggle Register (AIO0 to 31)
